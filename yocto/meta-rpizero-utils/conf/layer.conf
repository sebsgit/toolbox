## yocto/meta-rpizero-utils/conf/layer.conf
```bitbake
# We have a conf and classes directory, add to BBPATH
BBPATH .= ":${LAYERDIR}"

# We have recipes-* directories, add to BBFILES
BBFILES += "${LAYERDIR}/recipes-*/*/*.bb \
            ${LAYERDIR}/recipes-*/*/*.bbappend"

BBFILE_COLLECTIONS += "rpizero-utils"
BBFILE_PATTERN_rpizero-utils = "^${LAYERDIR}/"
BBFILE_PRIORITY_rpizero-utils = "10"

LAYERDEPENDS_rpizero-utils = "raspberrypi"
LAYERSERIES_COMPAT_rpizero-utils = "honister"
```
