/dts-v1/;
/plugin/;

/{

fragment@0 {
    target = <&fkdev1>;

    __overlay__ {
        status = "okay";
    };
};

fragment@1 {
    target = <&fkdev3>;

    __overlay__ {
        org,size = <24>;
    };
};

};